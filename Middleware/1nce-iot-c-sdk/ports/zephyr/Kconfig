## Middleware/1nce-iot-c-sdk/ports/zephyr/Kconfig
```kconfig
#
# Copyright (c) 2022 1NCE
# 1NCE IoT C SDK (ZEPHYR OS Module)
#

config ZEPHYR_NCE_SDK_MODULE
	bool "1NCE IoT C SDK"


if ZEPHYR_NCE_SDK_MODULE

config NCE_DEVICE_AUTHENTICATOR
	bool "Enable 1NCE Device Authenticator"
	default y
	help 
		use 1nce device authenticator to retrieve DTLS Security credentials.

config NCE_SDK_UDP_INTERFACE
	bool "Define a UDP interface for communication with 1NCE Endpoint"
	default y if NCE_DEVICE_AUTHENTICATOR
	help
	  Build and link common code that is shared across Golioth samples.

config NCE_ENERGY_SAVER
	bool "Enable 1NCE Energy Saver"
	default n
	help 
		use 1nce energy saver to optimize payload size.

config NCE_SDK_ATTEMPTS
	int "Max Onboarding attempts"
	default 5

config NCE_SDK_MAX_STRING_SIZE
	int "Max string size in the payload before conversion"
	default 50
	

module = NCE_SDK
module-str = NCE_SDK
source "${ZEPHYR_BASE}/subsys/logging/Kconfig.template.log_config"

endif # ZEPHYR_NCE_SDK_MODULE
```

## Middleware/1nce-iot-c-sdk/west.yml
```yaml
# Copyright (c) 2021 Nordic Semiconductor ASA
# SPDX-License-Identifier: Apache-2.0

manifest:
  self:
    path: modules/lib/nce-sdk
    west-commands: scripts/west-commands.yml

  remotes:
    - name: ncs
      url-base: https://github.com/nrfconnect
    - name: nce
      url-base: https://github.com/1NCE-GmbH

  projects:
    - name: nrf
      remote: ncs
      repo-path: sdk-nrf
      revision: v2.2.0
      import: true
    - name: nce-blueprint
      remote: nce
      repo-path: blueprint-zephyr
      revision: main
```
